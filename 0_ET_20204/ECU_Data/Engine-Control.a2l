ECU_Data2_VERSION 1 30
/begin PROJECT Mini_13D ""
/begin HEADER "" PROJECT_NO _056001_01 /end HEADER
/begin MODULE DIM ""
/begin MOD_PAR "" VERSION " " ADDR_EPK 0x0 EPK "" CUSTOMER_NO "" USER "K3/EAV3-Vogt(1689)" PHONE_NO "" ECU "" CPU_TYPE "80166"
 /begin MEMORY_LAYOUT PRG_CODE 0x800000 0x10000 -1 -1 -1 -1 -1 /begin IF_DATA ECU_Data1B_ETK DP_BLOB 0x800000 0x10000 /end IF_DATA /begin IF_DATA ECU_Data1B_MCMESS DP_BLOB 0x800000 0x10000 /end IF_DATA /end MEMORY_LAYOUT
 /begin MEMORY_LAYOUT PRG_CODE 0x820000 0x60000 -1 -1 -1 -1 -1 /begin IF_DATA ECU_Data1B_ETK DP_BLOB 0x820000 0x60000 /end IF_DATA /begin IF_DATA ECU_Data1B_MCMESS DP_BLOB 0x820000 0x60000 /end IF_DATA /end MEMORY_LAYOUT
 /begin MEMORY_LAYOUT PRG_DATA 0x810000 0x10000 -1 -1 -1 -1 -1 /begin IF_DATA ECU_Data1B_ETK DP_BLOB 0x810000 0x10000 /end IF_DATA /begin IF_DATA ECU_Data1B_MCMESS DP_BLOB 0x810000 0x10000 /end IF_DATA /end MEMORY_LAYOUT
/end MOD_PAR
/begin MOD_COMMON "" S_REC_LAYOUT DAMOS BYTE_ORDER MSB_LAST ALIGNMENT_BYTE 1 ALIGNMENT_WORD 2 ALIGNMENT_LONG 4 ALIGNMENT_FLOAT32_IEEE 4 ALIGNMENT_FLOAT64_IEEE 8 /end MOD_COMMON
/begin IF_DATA ECU_Data1B_ETK
 /begin SOURCE 100ms 3 100 /begin QP_BLOB 3 36 0x814D0A 0x380C50 0x381FFA 100 0 0 /end QP_BLOB /end SOURCE
 /begin SOURCE 10ms 3 10 /begin QP_BLOB 2 26 0x814CD4 0x380C36 0x381FF8 10 0 0 /end QP_BLOB /end SOURCE
 /begin SOURCE Synchro 103 3 /begin QP_BLOB 1 10 0x814CBE 0x380C2C 0x381FF6 0 0 0 /end QP_BLOB /end SOURCE
 /begin TP_BLOB 0x381FC0 1 39 12 2 0x0 0x0 0x0 0x0 0x0 0 ETK_CFG F F0 FF 3 FF EE FF 1 EXRAM 0x380000 0x387FFF -1 -1 -1 -1 -1 /end TP_BLOB
/end IF_DATA
/begin CHARACTERISTIC A0_KW "" VALUE 0x815CCE DAMOS_FW4 0.0 fak_sw_b0p125 -0.125 0.124996 /end CHARACTERISTIC
/begin CHARACTERISTIC ABAKN_GKL "" CURVE 0x819F96 DAMOS_GKL1 0.0 fak_ub_b1 0.0 0.99609399
 /begin AXIS_DESCR COM_AXIS nmot nmot_ub_q40 7 0.0 10200.0 AXIS_PTS_REF SNM07ESUB_GST MAX_GRAD 0.0 /end AXIS_DESCR
/end CHARACTERISTIC
/begin CHARACTERISTIC BRABEVI_KL "" CURVE 0x814E00 DAMOS_KL111 0.0 bfzg_uw_q0p1085 0.0 7110.5498 /begin AXIS_DESCR STD_AXIS vfzg_w vfzg_uw_b512 8 0.0 511.992 MAX_GRAD 0.0 /end AXIS_DESCR /end CHARACTERISTIC
/begin CHARACTERISTIC FIMHU_FKL "" CURVE 0x811680 DAMOS_FKL1 0.0 fak_ub_b2 0.0 1.99219
 /begin AXIS_DESCR FIX_AXIS nwCtr dez 16 0.0 15.0 MAX_GRAD 0.0 FIX_AXIS_PAR 0 0 16 /end AXIS_DESCR
/end CHARACTERISTIC
/begin CHARACTERISTIC KFZW_GKF "" MAP 0x812C80 DAMOS_GKF2 0.0 zw_sb_q0p75 -96.0 95.25
 /begin AXIS_DESCR COM_AXIS nmot nmot_ub_q40 16 0.0 10200.0 AXIS_PTS_REF SNM16ZUUB_GST MAX_GRAD 0.0 /end AXIS_DESCR
 /begin AXIS_DESCR COM_AXIS rl rel_ub_q0p75 12 0.0 191.25 AXIS_PTS_REF SRL12ZUUB_GST MAX_GRAD 0.0 /end AXIS_DESCR
/end CHARACTERISTIC
/begin AXIS_PTS SNM07ESUB_GST "" 0x818119 nmot DAMOS_SST97 0.0 nmot_ub_q40 7 0.0 10200.0 /end AXIS_PTS
/begin AXIS_PTS SNM16ZUUB_GST "" 0x810718 nmot DAMOS_SST97 0.0 nmot_ub_q40 16 0.0 10200.0 /end AXIS_PTS
/begin AXIS_PTS SRL12ZUUB_GST "" 0x810752 rl DAMOS_SST97 0.0 rel_ub_q0p75 12 0.0 191.25 /end AXIS_PTS
/begin MEASUREMENT B_4wd "" UWORD B_TRUE 0 0 0.0 0.0 /begin IF_DATA ECU_Data1B_ETK KP_BLOB 0xFD5A 0 2 /end IF_DATA /begin IF_DATA ECU_Data1B_MCMESS KP_BLOB 0xFD5A INTERN 2 /end IF_DATA /begin IF_DATA ECU_Data1B_KWP2000 KP_BLOB 0xFD5A 0 2 /end IF_DATA BIT_MASK 0x10 /end MEASUREMENT
/begin MEASUREMENT B_ml "" UWORD B_TRUE 0 0 0.0 0.0 /begin IF_DATA ECU_Data1B_ETK KP_BLOB 0xFD4C 0 2 /end IF_DATA /begin IF_DATA ECU_Data1B_MCMESS KP_BLOB 0xFD4C INTERN 2 /end IF_DATA /begin IF_DATA ECU_Data1B_KWP2000 KP_BLOB 0xFD4C 0 2 /end IF_DATA BIT_MASK 0x4 DISPLAY_IDENTIFIER B_aav /end MEASUREMENT
/begin MEASUREMENT B_abgle "" UWORD B_TRUE 0 0 0.0 0.0 /begin IF_DATA ECU_Data1B_ETK KP_BLOB 0xFD30 0 2 /end IF_DATA /begin IF_DATA ECU_Data1B_MCMESS KP_BLOB 0xFD30 INTERN 2 /end IF_DATA /begin IF_DATA ECU_Data1B_KWP2000 KP_BLOB 0xFD30 0 2 /end IF_DATA BIT_MASK 0x100 /end MEASUREMENT
/begin MEASUREMENT speed "velocity of the vehicle in km/h" UWORD B_TRUE 0 0 0.0 0.0 /begin IF_DATA ECU_Data1B_ETK KP_BLOB 0xFD5A 0 2 /end IF_DATA /begin IF_DATA ECU_Data1B_MCMESS KP_BLOB 0xFD5A INTERN 2 /end IF_DATA /begin IF_DATA ECU_Data1B_KWP2000 KP_BLOB 0xFD5A 0 2 /end IF_DATA BIT_MASK 0x20 /end MEASUREMENT
/begin MEASUREMENT measureArray "" UBYTE compuMethodName 0 0.0 0.0 255.0 ARRAY_SIZE 4 ECU_ADDRESS 0x100 MATRIX_DIM 4 /end MEASUREMENT
/begin MEASUREMENT n "Engine Speed" UBYTE nmot_ub_q40 0 0.0 0.0 10200.0 /begin IF_DATA ECU_Data1B_ETK KP_BLOB 0x380C74 1 1 /end IF_DATA /begin IF_DATA ECU_Data1B_MCMESS KP_BLOB 0x380C74 EXTERN 1 /end IF_DATA /begin IF_DATA ECU_Data1B_KWP2000 KP_BLOB 0x380C74 1 1 /end IF_DATA DISPLAY_IDENTIFIER N /end MEASUREMENT
/begin MEASUREMENT plsol "" UBYTE p_ub_q10 0 0.0 0.0 2550.0 /begin IF_DATA ECU_Data1B_ETK KP_BLOB 0x38103C 1 1 /end IF_DATA /begin IF_DATA ECU_Data1B_MCMESS KP_BLOB 0x38103C EXTERN 1 /end IF_DATA /begin IF_DATA ECU_Data1B_KWP2000 KP_BLOB 0x38103C 1 1 /end IF_DATA /end MEASUREMENT
/begin MEASUREMENT tmot "engine temperature" UBYTE temp_ub_q0p75_o48 0 0.0 -48.0 143.25 /begin IF_DATA ECU_Data1B_ETK KP_BLOB 0x3812B7 1 1 /end IF_DATA /begin IF_DATA ECU_Data1B_MCMESS KP_BLOB 0x3812B7 EXTERN 1 /end IF_DATA /begin IF_DATA ECU_Data1B_KWP2000 KP_BLOB 0x3812B7 1 1 /end IF_DATA /end MEASUREMENT
/begin MEASUREMENT VehTrStby "information if vehicle traction standby is established" UWORD B_TRUE 0 0 0.0 0.0 /begin IF_DATA ECU_Data1B_ETK KP_BLOB 0xFD5A 0 2 /end IF_DATA /begin IF_DATA ECU_Data1B_MCMESS KP_BLOB 0xFD5A INTERN 2 /end IF_DATA /begin IF_DATA ECU_Data1B_KWP2000 KP_BLOB 0xFD5A 0 2 /end IF_DATA BIT_MASK 0x20 /end MEASUREMENT
/begin MEASUREMENT recup "recuperation state -> 1=active" UWORD B_TRUE 0 0 0.0 0.0 /begin IF_DATA ECU_Data1B_ETK KP_BLOB 0xFD5A 0 2 /end IF_DATA /begin IF_DATA ECU_Data1B_MCMESS KP_BLOB 0xFD5A INTERN 2 /end IF_DATA /begin IF_DATA ECU_Data1B_KWP2000 KP_BLOB 0xFD5A 0 2 /end IF_DATA BIT_MASK 0x20 /end MEASUREMENT
/begin MEASUREMENT ub "battery voltage" UBYTE spg_ubatt___UB 0 0.0 0.0 17.952 /begin IF_DATA ECU_Data1B_ETK KP_BLOB 0x380C27 1 1 /end IF_DATA /begin IF_DATA ECU_Data1B_MCMESS KP_BLOB 0x380C27 EXTERN 1 /end IF_DATA /begin IF_DATA ECU_Data1B_KWP2000 KP_BLOB 0x380C27 1 1 /end IF_DATA /end MEASUREMENT
/begin COMPU_METHOD B_TRUE "boolean states, positive logic" TAB_VERB "%6.3" "" COMPU_TAB_REF B_TRUE /end COMPU_METHOD
/begin COMPU_METHOD bfzg_uw_q0p1085 "" RAT_FUNC "%6.3" "m/s^2" COEFFS 0 9.2165899 0.0 0 0.0 1.0 /end COMPU_METHOD
/begin COMPU_METHOD dez "1 : 1 conversion (dez/hex)" RAT_FUNC "%6.2" "" COEFFS 0 1 0 0 0 1 /end COMPU_METHOD
/begin COMPU_METHOD fak_sw_b0p125 "" RAT_FUNC "%8.7" "-" COEFFS 0 262144.0 0.0 0 0.0 1.0 /end COMPU_METHOD
/begin COMPU_METHOD fak_ub_b1 "" RAT_FUNC "%6.4" "-" COEFFS 0 256.0 0.0 0 0.0 1.0 /end COMPU_METHOD
/begin COMPU_METHOD fak_ub_b2 "" RAT_FUNC "%6.4" "-" COEFFS 0 128.0 0.0 0 0.0 1.0 /end COMPU_METHOD
/begin COMPU_METHOD nmot_ub_q40 "" RAT_FUNC "%6.1" "rpm" COEFFS 0 2.5e-002 0.0 0 0.0 1.0 /end COMPU_METHOD
/begin COMPU_METHOD nmot_uw_q0p25 "" RAT_FUNC "%6.3" "rpm" COEFFS 0 4.0 0.0 0 0.0 1.0 /end COMPU_METHOD
/begin COMPU_METHOD p_ub_q10 "" RAT_FUNC "%6.1" "hPa" COEFFS 0 0.1 0.0 0 0.0 1.0 /end COMPU_METHOD
/begin COMPU_METHOD rel_ub_b99p6 "" RAT_FUNC "%6.3" "%" COEFFS 0 2.56 0.0 0 0.0 1.0 /end COMPU_METHOD
/begin COMPU_METHOD rel_ub_q0p75 "" RAT_FUNC "%6.3" "%" COEFFS 0 1.3333333 0.0 0 0.0 1.0 /end COMPU_METHOD
/begin COMPU_METHOD spg_ubatt___UB "" RAT_FUNC "%6.4" "V" COEFFS 0 14.204545 0.0 0 0.0 1.0 /end COMPU_METHOD
/begin COMPU_METHOD temp_ub_q0p75_o48 "" RAT_FUNC "%6.2" "Grad C" COEFFS 0 1.3333333 64.0 0 0.0 1.0 /end COMPU_METHOD
/begin COMPU_METHOD UBQ "battery voltage" RAT_FUNC "%6.4" "V" COEFFS 0 14.204545 0.0 0 0.0 1.0 /end COMPU_METHOD
/begin COMPU_METHOD vfzg_uw_b512 "" RAT_FUNC "%6.4" "km/h" COEFFS 0 128.0 0.0 0 0.0 1.0 /end COMPU_METHOD
/begin COMPU_METHOD zw_sb_q0p75 "" RAT_FUNC "%6.3" "grad KW" COEFFS 0 1.3333333 0.0 0 0.0 1.0 /end COMPU_METHOD
/begin COMPU_VTAB B_TRUE "" TAB_VERB 2 0 ---- 1 TRUE /end COMPU_VTAB
/begin FUNCTION AAGR "" /end FUNCTION
/begin FUNCTION ADVE "" /end FUNCTION
/begin RECORD_LAYOUT DAMOS_FKL1 FNC_VALUES 1 UBYTE COLUMN_DIR DIRECT /end RECORD_LAYOUT
/begin RECORD_LAYOUT DAMOS_FW4 FNC_VALUES 1 SWORD COLUMN_DIR DIRECT /end RECORD_LAYOUT
/begin RECORD_LAYOUT DAMOS_GKF2 FNC_VALUES 1 SBYTE COLUMN_DIR DIRECT /end RECORD_LAYOUT
/begin RECORD_LAYOUT DAMOS_GKL1 FNC_VALUES 1 UBYTE COLUMN_DIR DIRECT /end RECORD_LAYOUT
/begin RECORD_LAYOUT DAMOS_KL111 FNC_VALUES 3 UWORD COLUMN_DIR DIRECT AXIS_PTS_X 2 UWORD INDEX_INCR DIRECT NO_AXIS_PTS_X 1 UBYTE /end RECORD_LAYOUT
/begin RECORD_LAYOUT DAMOS_KL111_Original FNC_VALUES 4 UWORD COLUMN_DIR DIRECT AXIS_PTS_X 3 UWORD INDEX_INCR DIRECT NO_AXIS_PTS_X 2 UBYTE SRC_ADDR_X 1 UWORD /end RECORD_LAYOUT
/begin RECORD_LAYOUT DAMOS_SST97 AXIS_PTS_X 2 UBYTE INDEX_INCR DIRECT NO_AXIS_PTS_X 1 UBYTE /end RECORD_LAYOUT
/begin RECORD_LAYOUT DAMOS_SST97_Original AXIS_PTS_X 3 UBYTE INDEX_INCR DIRECT NO_AXIS_PTS_X 2 UBYTE SRC_ADDR_X 1 UWORD /end RECORD_LAYOUT
/end MODULE
/end PROJECT
